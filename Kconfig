## Kconfig
```kconfig
mainmenu "YoriCore Simulation Configuration"

menu "Debug"
config WAVE
  bool "Generate waveform"
  default n
endmenu

menu "Memory"
config MBASE
  hex "Memory base address"
  default 0x80000000

config MSIZE
  hex "Memory size"
  default 0x1000000

config PC_RESET_OFFSET
  hex "Offset of reset vector from memory base"
  default 0x0

config MEM_RANDOM
  bool "Randomize memory on init"
  default n
endmenu


menu "Devices"
config RTC_ADDR
  hex "RTC MMIO base address"
  default 0x0200B000

config SERIAL_PORT
  hex "UART MMIO base address"
  default 0x10000000
endmenu

menu "Halt device"
config HALT_ADDR
  hex "Halt/tohost device address (1-byte write)"
  default 0xF0000000
endmenu

menu "Difftest"
config DIFFTEST
  bool "Enable difftest"
  default y

config DIFFTEST_DEFAULT_ON
  bool "Enable difftest at startup"
  depends on DIFFTEST
  default n

config DIFFTEST_REF_PATH
  string "Reference .so path"
  depends on DIFFTEST
  default "build/ref/riscv32-spike-so"
endmenu

config MAX_CYCLES
  int "Max cycles per cpu_exec run"
  default 2000000
```

## defconfig
```kconfig
CONFIG_DIFFTEST=y
# CONFIG_DIFFTEST_DEFAULT_ON is not set
CONFIG_DIFFTEST_REF_PATH="build/ref/riscv32-spike-so"
CONFIG_MBASE=0x80000000
CONFIG_MSIZE=0x1000000
CONFIG_PC_RESET_OFFSET=0x0
# CONFIG_MEM_RANDOM is not set
CONFIG_SYSCON_ADDR=0x00100000
CONFIG_CLINT_ADDR=0x02000000
CONFIG_PLIC_ADDR=0x0C000000
CONFIG_RTC_ADDR=0x00101000
CONFIG_SERIAL_PORT=0x10000000
CONFIG_HALT_ADDR=0xF0000000
CONFIG_MAX_CYCLES=2000000
# CONFIG_WAVE is not set
```
